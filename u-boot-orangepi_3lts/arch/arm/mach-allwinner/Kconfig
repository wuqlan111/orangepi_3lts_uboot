## u-boot-orangepi_3lts/arch/arm/mach-allwinner/Kconfig
```kconfig
if ARCH_ALLWINNER

config H6_V200
	bool "allwinner h6 family"
	select ARM64
	select ARMV8_SET_SMPEN
	select MISC
	select SUPPORT_SPL
	select ALLWINNER_DRAM_DW
	select ALLWINNER_DRAM_DW_32BIT
	imply  SPL_TIMER if SPL
	imply  SPL_LOAD_FIT  if SPL
	imply  SPL_FRAMEWORK  if SPL
	imply  SPL_PRINTF  if SPL

choice
	prompt "SPL Image Type"
	default SPL_IMAGE_TYPE_ALLWINNER_EGON

config SPL_IMAGE_TYPE_ALLWINNER_EGON
	bool "eGON (normal)"
	help
	  Select this option to embed the SPL binary in an eGON.BT0 image,
	  which is compatible with the normal boot ROM (NBROM).

	  This is usually the correct option to choose.

config SPL_IMAGE_TYPE_ALLWINNER_TOC0
	bool "TOC0 (secure)"
	help
	  Select this option to embed the SPL binary in a TOC0 image,
	  which is compatible with the secure boot ROM (SBROM).

endchoice

config SPL_IMAGE_TYPE
	string
	default "sunxi_egon" if SPL_IMAGE_TYPE_ALLWINNER_EGON
	default "sunxi_toc0" if SPL_IMAGE_TYPE_ALLWINNER_TOC0

config ARM_BOOT_HOOK_RMR
	bool
	depends on ARM64
	default y
	select ENABLE_ARM_SOC_BOOT0_HOOK
	---help---
	Insert some ARM32 code at the very beginning of the U-Boot binary
	which uses an RMR register write to bring the core into AArch64 mode.
	The very first instruction acts as a switch, since it's carefully
	chosen to be a NOP in one mode and a branch in the other, so the
	code would only be executed if not already in AArch64.
	This allows both the SPL and the U-Boot proper to be entered in
	either mode and switch to AArch64 if needed.


config RESERVE_ALLWINNER_BOOT0_HEADER
	bool "reserve space for Allwinner boot0 header"
	select ENABLE_ARM_SOC_BOOT0_HOOK
	---help---
	Prepend a 1536 byte (empty) header to the U-Boot image file, to be
	filled with magic values post build. The Allwinner provided boot0
	blob relies on this information to load and execute U-Boot.
	Only needed on 64-bit Allwinner boards so far when using boot0.

config ALLWINNER_SRAM_ADDRESS
	hex
	default 0x20000
	help
		Older Allwinner SoCs have their mask boot ROM mapped just below 4GB,
		with the first SRAM region being located at address 0.
		Some newer SoCs map the boot ROM at address 0 instead and move the
		SRAM to a different address.

config SYS_SOC
	default "allwinner"

config DRAM_CLK
	int "allwinner dram clock speed"
	default 744 if H6_V200
	help
		Set the dram clock speed, valid range 240 - 480 (prior to sun9i),
		must be a multiple of 24. For the sun9i (A80), the tested values
		(for DDR3-1600) are 312 to 792.


config DRAM_ZQ
	int "allwinner dram zq value"
	default 3881979 if H6_V200
	help
		Set the dram zq value.


config DRAM_ODT_EN
	bool "allwinner dram odt enable"
	default y if MACH_SUN50I
	default y if MACH_SUN50I_H6
	default y if H6_V200
	help
		Select this to enable dram odt (on die termination).


config ALLWINNER_DRAM_DW
	bool
	---help---
	Select this for sunxi SoCs which uses a DRAM controller like the
	DesignWare controller used in H3, mainly SoCs after H3, which do
	not have official open-source DRAM initialization code, but can
	use modified H3 DRAM initialization code.

if ALLWINNER_DRAM_DW
config ALLWINNER_DRAM_DW_16BIT
	bool
	---help---
	Select this for sunxi SoCs with DesignWare DRAM controller and
	have only 16-bit memory buswidth.

config ALLWINNER_DRAM_DW_32BIT
	bool
	---help---
	Select this for sunxi SoCs with DesignWare DRAM controller with
	32-bit memory buswidth.
endif


if ALLWINNER_DRAM_DW || DRAM_ALLWINNER_H6
config ALLWINNER_DRAM_DDR3
	bool

config ALLWINNER_DRAM_DDR2
	bool

config ALLWINNER_DRAM_LPDDR3
	bool

choice
	prompt "DRAM Type and Timing"
	default ALLWINNER_DRAM_DDR3_1333 if !MACH_SUN8I_V3S
	default ALLWINNER_DRAM_DDR2_V3S if MACH_SUN8I_V3S

config ALLWINNER_DRAM_DDR3_1333
	bool "DDR3 1333"
	select ALLWINNER_DRAM_DDR3
	depends on !MACH_SUN8I_V3S
	---help---
	This option is the original only supported memory type, which suits
	many H3/H5/A64 boards available now.

config ALLWINNER_DRAM_LPDDR3_STOCK
	bool "LPDDR3 with Allwinner stock configuration"
	select ALLWINNER_DRAM_LPDDR3
	---help---
	This option is the LPDDR3 timing used by the stock boot0 by
	Allwinner.

config ALLWINNER_DRAM_H6_LPDDR3
	bool "LPDDR3 DRAM chips on the H6 DRAM controller"
	select ALLWINNER_DRAM_LPDDR3
	depends on DRAM_ALLWINNER_H6
	---help---
	This option is the LPDDR3 timing used by the stock boot0 by
	Allwinner.

config ALLWINNER_DRAM_H6_DDR3_1333
	bool "DDR3-1333 boot0 timings on the H6 DRAM controller"
	select ALLWINNER_DRAM_DDR3
	depends on DRAM_ALLWINNER_H6
	---help---
	This option is the DDR3 timing used by the boot0 on H6 TV boxes
	which use a DDR3-1333 timing.

config ALLWINNER_DRAM_DDR2_V3S
	bool "DDR2 found in V3s chip"
	select ALLWINNER_DRAM_DDR2
	depends on MACH_SUN8I_V3S
	---help---
	This option is only for the DDR2 memory chip which is co-packaged in
	Allwinner V3s SoC.

endchoice
endif



endif
```

## u-boot-orangepi_3lts/arch/arm/mach-allwinner/h6-v200/Kconfig
```kconfig
config H6_V200
	bool "allwinner h6 family"
	select ARM64
	select ARMV8_SET_SMPEN
	select ARCH_SUPPORT_TFABOOT
	select DM
	select DM_EVENT
	select OF_CONTROL
	select MISC
	select SUPPORT_SPL
	imply SPL_SEPARATE_BSS if SPL
	imply CMD_DM
	imply SPL_DM  if SPL
	imply SPL_SERIAL if SPL
	imply SPL_TIMER if SPL
```

## u-boot-orangepi_3lts/board/allwinner/h6_v200/Kconfig
```kconfig
if H6_V200

config SYS_VENDOR
	default "allwinner"

config SYS_BOARD
	default "h6_v200"

config SYS_CONFIG_NAME
	default "allwinner_h6_devboard"

endif
```

## u-boot-orangepi_3lts/configs/allwinner_h6_v200_defconfig
```kconfig
CONFIG_ARM=y
CONFIG_ARCH_ALLWINNER=y
CONFIG_H6_V200=y
CONFIG_SYS_CONFIG_NAME="allwinner_h6_devboard"
CONFIG_SYS_MALLOC_LEN=0x1000000
CONFIG_NR_DRAM_BANKS=1
CONFIG_HAS_CUSTOM_SYS_INIT_SP_ADDR=y
CONFIG_CUSTOM_SYS_INIT_SP_ADDR=0x40200000
CONFIG_DEFAULT_DEVICE_TREE="allwinner-h6-v200"

# env config
CONFIG_ENV_ADDR=0x4000000
CONFIG_ENV_SIZE=0x40000
CONFIG_ENV_SECT_SIZE=0x40000
CONFIG_ENV_IS_IN_FLASH=y

# debug uart config
CONFIG_DEBUG_UART=y
CONFIG_DEBUG_UART_BASE=0x05000000
CONFIG_DEBUG_UART_CLOCK=12000000
CONFIG_DEBUG_UART_ALLWINNER=y

# boot config
CONFIG_BOOTSTD_FULL=y
CONFIG_BOOTSTD_DEFAULTS=y
CONFIG_LEGACY_IMAGE_FORMAT=y
CONFIG_SYS_BOOTM_LEN=0x4000000


# console io buffer size
CONFIG_SYS_CBSIZE=1024
CONFIG_SYS_PBSIZE=1024
CONFIG_CONSOLE_FLUSH_SUPPORT=n

# cmd config
# CONFIG_CMD_MTD=y
# CONFIG_CMD_MTDPARTS=y

# flash config
# CONFIG_MTD=y
# CONFIG_DM_MTD=y
# CONFIG_MTD_PARTITIONS=y
# CONFIG_SYS_FLASH_USE_BUFFER_WRITE=y
# CONFIG_FLASH_SHOW_PROGRESS=0
# CONFIG_MTD_RAW_NAND=y
CONFIG_PSCI_RESET=n

# serial config
CONFIG_DM_SERIAL=y
CONFIG_ALLWINNER_SERIAL=y


# clk config
CONFIG_CLK=y
CONFIG_ALLWINNER_H6_GPIO=y

# pinctrl config
CONFIG_PINCTRL=y
CONFIG_PINCTRL_ALLWINNER_H6_V200=y

# SPL config
CONFIG_SPL=y
CONFIG_SPL_STACK_R=y
CONFIG_SPL_STACK_R_ADDR=0x4fe00000
CONFIG_SPL_BSS_START_ADDR=0x4ff80000
CONFIG_SPL_BSS_MAX_SIZE=0x00800000

# H6-v200 sdram space (0x40000000 - 0xffffffff)
CONFIG_SYS_LOAD_ADDR=0x42000000

CONFIG_DRAM_ODT_EN=y
CONFIG_ALLWINNER_DRAM_H6_LPDDR3=y
CONFIG_ALLWINNER_DRAM_DDR3=n

CONFIG_WDT=y
# CONFIG_MMC_TRACE=y
# CONFIG_MMC_VERBOSE=y

# cmd config
CONFIG_CMD_DM=y
CONFIG_CMD_GPIO=y
CONFIG_CMD_GPIO_READ=y
CONFIG_CMD_MMC=y
CONFIG_CMD_CLK=y
CONFIG_CMD_PINMUX=y
CONFIG_CMD_TIMER=y
CONFIG_CMD_WDT=y
```

## u-boot-orangepi_3lts/drivers/clk/allwinner/Kconfig
```kconfig
config CLK_ALLWINNER_H6
	bool "Enable clock driver support for STM32F family"
	depends on CLK && H6_V200
	default y
	help
	  This clock driver adds support for CCU clock management
	  for ALLWINNER_H6 SoCs.
```

## u-boot-orangepi_3lts/drivers/pinctrl/allwinner/Kconfig
```kconfig
config PINCTRL_ALLWINNER_H6_V200
	depends on ARCH_ALLWINNER && H6_V200 && PINCTRL
	default y
	bool "Allwinner H6 family pin control driver"
	help
	   Support pin multiplexing and pin configuration control on
	   Allwinner H6 family of SoCs.
```
